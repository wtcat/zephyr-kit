## bsps/boards/arm/apollo3p/Kconfig.board
```kconfig
# APOLLO3P board configuration

config BOARD_APOLLO3P
	bool "APOLLO3P Development Board"
	depends on SOC_APOLLO3P
```

## bsps/boards/arm/apollo3p/apollo3p_defconfig
```kconfig
# SPDX-License-Identifier: Apache-2.0

#CONFIG_SOC_SERIES_APOLLO=y
#CONFIG_SOC_APOLLO3P=y

# 48MHz system clock
CONFIG_SYS_CLOCK_HW_CYCLES_PER_SEC=48000000
CONFIG_SYS_CLOCK_TICKS_PER_SEC=100

CONFIG_SERIAL=n

# console
CONFIG_CONSOLE=n
CONFIG_UART_CONSOLE=n

# enable pinmux
CONFIG_PINMUX=n

# enable GPIO
CONFIG_GPIO=n

# clock configuration
CONFIG_CLOCK_CONTROL=n
```

## bsps/drivers/zephyr/Kconfig
```kconfig
# Device driver configure menu

menuconfig APOLLO3P_DEVICE
	bool "Device Drivers"
	help
	  Enable options for apollo3p device drivers.


if APOLLO3P_DEVICE

rsource "serial/Kconfig"
rsource "gpio/Kconfig"
rsource "i2c/Kconfig"
rsource "misc/Kconfig"

endif #APOLLO3P_DEVICE
```

## bsps/drivers/zephyr/flash/Kconfig
```kconfig
menu "Flash Device"

config APOLLO_MSPI_NOR
  bool "Apollo mspi nor-flash"
  select MSPI_APOLLO3P
  help
    Flash device model is mx25u512g
  
menuconfig  APOLLO_SOC_FLAH
	bool "apollo3 flash driver"
	select FLASH_HAS_PAGE_LAYOUT
	select FLASH_HAS_DRIVER_ENABLED
	default y
	help
	  Enable options for soc flash drivers.

if APOLLO_SOC_FLAH
  #rsource "Kconfig.apoolo3p_soc_flash"
endif

endmenu
```

## bsps/drivers/zephyr/kscan/Kconfig.cyttsp5
```kconfig
menuconfig KSCAN_CYTTSP5
	bool "CYTTSP5 capacitive touch panel driver"
	depends on I2C
	help
	  Enable driver for multiple Focaltech capacitive touch panel
	  controllers. This driver should support CYTTSP5.

if KSCAN_CYTTSP5

config KSCAN_CYTTSP5_INTERRUPT
	bool "Enable interrupt"
    default y
	help
	  Enable interrupt support (requires GPIO).

endif # KSCAN_FT5336
```

## bsps/drivers/zephyr/misc/Kconfig
```kconfig
# GPIO driver configuration options

menuconfig MISC
	bool "No-standard driver"
	help
	  Enable options for MISC driver.

if MISC
comment "MISC Drivers"

rsource "Kconfig.ite7259"
rsource "Kconfig.rm6903"
	  
endif # MISC
```

## bsps/drivers/zephyr/misc/Kconfig.rm6903
```kconfig
menuconfig LCD
	bool "LCD Drivers"
	help
	  Enable options for LCD driver.

if LCD
comment "LCD Drivers"

config LCD_APOLLO3P
	bool "RM6903 for APOLLO3P driver"
	help
	  This option enables the LCD driver for APOLLO3P
	  
endif # LCD
```

## bsps/soc/arm/ambiq_apollo3p/Kconfig.defconfig
```kconfig
# SPDX-License-Identifier: Apache-2.0

config SOC
    default "ambiq_apollo3p"

config NUM_IRQS
	default 34
```

## components/Kconfig
```kconfig
# Components menu

rsource "ble/Kconfig"

menuconfig GUIX
	bool "GUIX for zephyr"
	help
	  Enable options for GUIX.
if GUIX
  rsource "gui/Kconfig"
endif

menuconfig XMODEM
	bool "xmodem"
	default y
	help
	  Enable options for xmodem

rsource "stp/Kconfig"
rsource "protobuf-c/Kconfig"
rsource "services/Kconfig"
rsource "motion/Kconfig"
```

## components/ble/ble-profiles/sources/profiles/Kconfig
```kconfig
# BLE profiles

menu "Profiles"

config BLE_PROFILES_DIS
    bool "dis"

config BLE_PROFILES_GATT
    bool "gatt"

config BLE_PROFILES_GAP
    bool "gap"
    
config BLE_PROFILES_HID
    bool "hid"

endmenu

    
```

## project_wkpace/gui/Kconfig
```kconfig
menuconfig WATCH_FACE_TEST
	bool "watch face test"
	help
	  Enable options for watch face test.
```

## project_wkpace/testsuite/Kconfig
```kconfig
# Testsuite


menu "Unit Test" 
config FATFS_TEST
  bool "FAT filesystem test"
  depends on FAT_FILESYSTEM_ELM
  
config GPIO_TEST
  bool "GPIO driver test"
  depends on GPIO
  
config LIS2DH_TEST
  bool "LIS2DH sensor(G-SENSOR) test"

config ADC_TEST
  bool "ADC test"
  
rsource "ble/Kconfig"
endmenu
```

## project_wkpace/west.yml
```yaml
# The west manifest file for upstream Zephyr.
#
# The per-installation west configuration file, .west/config, sets the
# path to the project containing this file in the [manifest] section's
# "path" variable.
#
# You are free to create your own manifest files and put them in any
# repository you want, to create your own custom Zephyr installations.
# For example, you could create a manifest file in your own out of
# tree application directory, which would pull this zephyr repository
# in as an ordinary project.
#
# You can pass your manifest repositories to west init when creating a
# new Zephyr installation. See the west documentation for more
# information.

manifest:
  defaults:
    remote: upstream

  remotes:
    - name: upstream
      url-base: https://github.com/zephyrproject-rtos

  #
  # Please add items below based on alphabetical order
  projects:
    - name: fatfs
      revision: 1d1fcc725aa1cb3c32f366e0c53d7490d0fe1109
      path: modules/fs/fatfs
    - name: lvgl
      revision: 31acbaa36e9e74ab88ac81e3d21e7f1d00a71136
      path: modules/lib/gui/lvgl
    - name: mbedtls
      revision: 24d84ecff195fb15c889d9046e44e4804d626c67
      path: modules/crypto/mbedtls
    - name: mcuboot
      revision: 3fc59410b633a6d83bbb534e43aac43160f9bd32
      path: bootloader/mcuboot
    - name: net-tools
      revision: 41132e9220f8bc1223084975350c5e5f3b492afe
      path: tools/net-tools
    - name: loramac-node
      revision: 3f545d76a2e6d1db83a470ccdb5bebd1f484e137
      path: modules/lib/loramac-node
    - name: segger
      revision: 38c79a447e4a47d413b4e8d34448316a5cece77c
      path: modules/debug/segger
    - name: tinycrypt
      path: modules/crypto/tinycrypt
      revision: 3e9a49d2672ec01435ffbf0d788db6d95ef28de0
    - name: littlefs
      path: modules/fs/littlefs
      revision: 9e4498d1c73009acd84bb36036ee5e2869112a6c

  self:
    path: zephyr
    west-commands: scripts/west-commands.yml
```
